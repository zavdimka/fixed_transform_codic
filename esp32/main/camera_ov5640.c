#include "camera_ov5640.h"

#include "board_pins.h"
#include "driver/i2c_master.h"
#include "esp_log.h"
#include "freertos/FreeRTOS.h"
#include "freertos/task.h"

#define CAMERA_I2C_ADDRESS 0x3c
#define CAMERA_I2C_CLOCK_HZ 100000
#define OV5640_CHIP_ID_HIGH 0x300a
#define OV5640_CHIP_ID_LOW 0x300b

typedef struct {
    uint16_t address;
    uint8_t value;
} camera_register_t;

// Common sensor and ISP initialization from the upstream Zephyr OV5640
// driver. The DVP-only table below is not sufficient after a software reset:
// without these values AWB, the colour matrix, gamma and UV processing remain
// at reset state and nominal YUV422 data has severely clipped chroma.
static const camera_register_t s_common_isp[] = {
    {0x3008,0x42},{0x3103,0x13},{0x3103,0x03},{0x3000,0x00},
    {0x3004,0xff},{0x3002,0x1c},{0x3006,0xc3},{0x302e,0x08},
    {0x3618,0x00},{0x3612,0x29},{0x3708,0x64},{0x3709,0x52},
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    {0x3a1e,0x26},{0x3a11,0x60},{0x3a1f,0x14},

    // Automatic white balance.
    {0x5180,0xff},{0x5181,0xf2},{0x5182,0x00},{0x5183,0x14},
    {0x5184,0x25},{0x5185,0x24},{0x5186,0x09},{0x5187,0x09},
    {0x5188,0x09},{0x5189,0x88},{0x518a,0x54},{0x518b,0xee},
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    {0x519c,0x09},{0x519d,0x2b},{0x519e,0x38},

    // Colour matrix, sharpening and gamma curve.
    {0x5381,0x1e},{0x5382,0x5b},{0x5383,0x08},{0x5384,0x0a},
    {0x5385,0x7e},{0x5386,0x88},{0x5387,0x7c},{0x5388,0x6c},
    {0x5389,0x10},{0x538a,0x01},{0x538b,0x98},
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    {0x5589,0x10},{0x558a,0x00},{0x558b,0xf8},

    // Enable the initialized ISP stages but leave lens shading off until its
    // module-specific table has been calibrated for this camera board.
    {0x5000,0x27},
};

// DVP bring-up values derived from the upstream Zephyr OV5640 driver, followed
// by its 1280x720 crop and the deliberately slow pixel timing required by the
// present FPGA transmitter.
static const camera_register_t s_dvp_720p[] = {
    {0x4740,0x21},{0x4050,0x6e},{0x4051,0x8f},
    {0x3017,0xff},{0x3018,0xff},{0x302c,0x02},{0x3108,0x01},{0x3630,0x2e},
    {0x3a18,0x00},{0x3a19,0xf8},{0x3635,0x1c},{0x3c04,0x28},
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    {0x3a14,0x05},{0x3a15,0xc4},{0x300e,0x58},{0x302e,0x00},
    // Keep the module's native DVP line mapping and select standard YUYV.
    {0x4300,0x30},{0x501f,0x00},{0x4713,0x04},{0x4407,0x04},
    {0x460b,0x35},{0x460c,0x22},{0x3824,0x02},{0x3406,0x01},
    {0x3400,0x06},{0x3401,0x80},{0x3402,0x04},{0x3403,0x00},
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    {0x3a0d,0x08},{0x3a14,0x07},{0x3a15,0xae},
    // 1280x720 capture with the FPGA's 16.5 MHz MCLK and /8 DVP PCLK setting.
    // HTS=2460 measures 30.1..30.2 FPS and is stable with the 66 MHz codec;
    // the old HTS=4100 setting produced only about 18.1 FPS.
    {0x3800,0x00},{0x3801,0x00},{0x3802,0x00},{0x3803,0xfa},
    {0x3804,0x0a},{0x3805,0x3f},{0x3806,0x06},{0x3807,0xa9},
    {0x3808,0x05},{0x3809,0x00},{0x380a,0x02},{0x380b,0xd0},
    {0x380c,0x09},{0x380d,0x9c},{0x380e,0x02},{0x380f,0xe4},
    {0x3810,0x00},{0x3811,0x10},{0x3812,0x00},{0x3813,0x04},
    {0x3814,0x31},{0x3815,0x31},{0x3824,0x08},{0x460c,0x20},
    {0x3008,0x02},
};
static const char *TAG = "camera_ov5640";
static i2c_master_bus_handle_t s_bus;
static i2c_master_dev_handle_t s_device;

esp_err_t camera_ov5640_start(void)
{
    if (s_device != NULL) {
        return ESP_OK;
    }

    const i2c_master_bus_config_t bus_config = {
        .i2c_port = I2C_NUM_0,
        .sda_io_num = BOARD_PIN_TWI_SDA,
        .scl_io_num = BOARD_PIN_TWI_SCK,
        .clk_source = I2C_CLK_SRC_DEFAULT,
        .glitch_ignore_cnt = 7,
        .flags.enable_internal_pullup = false,
    };
    esp_err_t err = i2c_new_master_bus(&bus_config, &s_bus);
    if (err != ESP_OK) {
        ESP_LOGE(TAG, "cannot initialize SCCB bus: %s",
                 esp_err_to_name(err));
        return err;
    }

    err = i2c_master_probe(s_bus, CAMERA_I2C_ADDRESS, 100);
    if (err != ESP_OK) {
        ESP_LOGE(TAG, "no response at SCCB address 0x%02x: %s",
                 CAMERA_I2C_ADDRESS, esp_err_to_name(err));
        return err;
    }

    const i2c_device_config_t device_config = {
        .dev_addr_length = I2C_ADDR_BIT_LEN_7,
        .device_address = CAMERA_I2C_ADDRESS,
        .scl_speed_hz = CAMERA_I2C_CLOCK_HZ,
    };
    err = i2c_master_bus_add_device(s_bus, &device_config, &s_device);
    if (err != ESP_OK) {
        ESP_LOGE(TAG, "cannot add OV5640 SCCB device: %s",
                 esp_err_to_name(err));
    }
    return err;
}

esp_err_t camera_ov5640_read_register(uint16_t address, uint8_t *value)
{
    if (value == NULL) {
        return ESP_ERR_INVALID_ARG;
    }
    esp_err_t err = camera_ov5640_start();
    if (err != ESP_OK) {
        return err;
    }
    const uint8_t register_address[] = {
        (uint8_t)(address >> 8), (uint8_t)address,
    };
    return i2c_master_transmit_receive(s_device, register_address,
                                       sizeof(register_address), value, 1, 100);
}

esp_err_t camera_ov5640_probe(uint16_t *chip_id)
{
    uint8_t high = 0;
    uint8_t low = 0;
    esp_err_t err = camera_ov5640_read_register(OV5640_CHIP_ID_HIGH, &high);
    if (err == ESP_OK) {
        err = camera_ov5640_read_register(OV5640_CHIP_ID_LOW, &low);
    }
    if (err == ESP_OK) {
        const uint16_t id = ((uint16_t)high << 8) | low;
        if (chip_id != NULL) {
            *chip_id = id;
        }
        ESP_LOGI(TAG, "SCCB responded, chip ID=0x%04x", id);
        if (id != 0x5640) {
            err = ESP_ERR_NOT_FOUND;
        }
    }
    return err;
}

static esp_err_t camera_ov5640_write_register(uint16_t address, uint8_t value)
{
    esp_err_t err = camera_ov5640_start();
    if (err != ESP_OK) {
        return err;
    }
    const uint8_t command[] = {
        (uint8_t)(address >> 8), (uint8_t)address, value,
    };
    return i2c_master_transmit(s_device, command, sizeof(command), 100);
}

esp_err_t camera_ov5640_set_test_pattern(bool enabled)
{
    return camera_ov5640_write_register(0x503d, enabled ? 0x80 : 0x00);
}

esp_err_t camera_ov5640_set_yuv_order(uint8_t order)
{
    if (order > 3) {
        return ESP_ERR_INVALID_ARG;
    }
    return camera_ov5640_write_register(0x4300, 0x30 | order);
}
esp_err_t camera_ov5640_set_hts(uint16_t hts)
{
    // 1896 is the native 1280x720 line length for this PLL setup. Smaller
    // values would truncate horizontal blanking and are intentionally rejected.
    if (hts < 1896) {
        return ESP_ERR_INVALID_ARG;
    }
    esp_err_t err =
        camera_ov5640_write_register(0x380c, (uint8_t)(hts >> 8));
    if (err == ESP_OK) {
        err = camera_ov5640_write_register(0x380d, (uint8_t)hts);
    }
    return err;
}
esp_err_t camera_ov5640_configure_720p(void)
{
    uint16_t chip_id = 0;
    esp_err_t err = camera_ov5640_probe(&chip_id);
    if (err != ESP_OK) {
        return err;
    }

    err = camera_ov5640_write_register(0x3008, 0x82);
    if (err != ESP_OK) {
        return err;
    }
    vTaskDelay(pdMS_TO_TICKS(20));

    for (size_t index = 0;
         index < sizeof(s_common_isp) / sizeof(s_common_isp[0]); ++index) {
        err = camera_ov5640_write_register(s_common_isp[index].address,
                                           s_common_isp[index].value);
        if (err != ESP_OK) {
            ESP_LOGE(TAG, "common register 0x%04x failed at index %u: %s",
                     s_common_isp[index].address, (unsigned)index,
                     esp_err_to_name(err));
            return err;
        }
    }

    for (size_t index = 0;
         index < sizeof(s_dvp_720p) / sizeof(s_dvp_720p[0]); ++index) {
        err = camera_ov5640_write_register(s_dvp_720p[index].address,
                                           s_dvp_720p[index].value);
        if (err != ESP_OK) {
            ESP_LOGE(TAG, "register 0x%04x failed at index %u: %s",
                     s_dvp_720p[index].address, (unsigned)index,
                     esp_err_to_name(err));
            return err;
        }
    }
    vTaskDelay(pdMS_TO_TICKS(100));
    ESP_LOGI(TAG, "configured 1280x720 YUV422 DVP");
    return ESP_OK;
}
